## sdkconfig.defaults
```kconfig
CONFIG_ESPTOOLPY_FLASHSIZE_4MB=y
CONFIG_ESPTOOLPY_FLASHSIZE="4MB"

CONFIG_ESP_HTTP_CLIENT_ENABLE_HTTPS=y
CONFIG_ESP_MAIN_TASK_STACK_SIZE=8192

CONFIG_FATFS_LFN_STACK=y
CONFIG_FATFS_MAX_LFN=99

CONFIG_ESP32_SPIRAM_SUPPORT=y
```
